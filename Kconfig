## Kconfig
```kconfig
# Sensor data simulator
#
# Copyright (c) 2019 Nordic Semiconductor
#
# SPDX-License-Identifier: LicenseRef-Nordic-5-Clause
#

menuconfig PMW3610
    bool "PMW3610 mouse optical sensor"
    select SPI
    help
      Enable support for the PMW3610 optical trackball sensor.

if PMW3610

config PMW3610_SMART_ALGORITHM
    bool "Enable smart surface coverage algorithm"
    default y
    help
      Enable the PMW3610’s built-in smart algorithm for improved tracking on various surfaces.

config PMW3610_CPI
    int "PMW3610 default CPI"
    default 800
    range 200 3200
    help
      Sets the sensor resolution in Counts Per Inch (CPI). Must be a multiple of 200 between 200 and 3200.

config PMW3610_CPI_DIVIDOR
    int "PMW3610 CPI divisor"
    default 1
    range 1 100
    help
      Divides the sensor’s reported movement by this value. Use 1 for normal speed, or higher values to slow down cursor movement.

config PMW3610_SNIPE_CPI
    int "PMW3610 CPI in snipe mode"
    default 200
    range 200 3200
    help
      Alternate CPI to use when “snipe mode” is activated (e.g., for fine control). Must be a multiple of 200.

config PMW3610_SNIPE_CPI_DIVIDOR
    int "PMW3610 CPI divisor in snipe mode"
    default 1
    range 1 100
    help
      Divides movement in snipe mode by this value (similar to CPI_DIVIDOR, but applied only in snipe mode).

config PMW3610_SCROLL_TICK
    int "PMW3610 scroll tick threshold"
    default 20
    help
      The amount of sensor movement (in arbitrary units) required to generate one scroll step. Smaller values make scrolling more sensitive.

choice
    prompt "PMW3610 polling rate"
    default PMW3610_POLLING_RATE_250

config PMW3610_POLLING_RATE_250
    bool "250 Hz"

config PMW3610_POLLING_RATE_125
    bool "125 Hz"

config PMW3610_POLLING_RATE_125_SW
    bool "125 Hz (software implementation)"

endchoice

config PMW3610_FORCE_AWAKE
    bool "Force PMW3610 awake (disable sleep modes)"
    help
      If enabled, the sensor will remain in RUN mode (active) and never enter lower power rest modes.

config PMW3610_RUN_DOWNSHIFT_TIME_MS
    int "RUN mode downshift time (ms)"
    default 128
    range 13 3264
    help
      Time in milliseconds before the sensor enters REST1 mode from RUN mode (when no motion is detected). A larger value keeps the sensor in RUN mode longer.

config PMW3610_REST1_SAMPLE_TIME_MS
    int "REST1 mode sample period (ms)"
    default 40
    range 10 2550
    help
      Interval in milliseconds between sensor checks in REST1 (first low-power) mode.

config PMW3610_REST1_DOWNSHIFT_TIME_MS
    int "REST1 mode downshift time (ms)"
    default 9600
    help
      Time in milliseconds before the sensor enters REST2 mode from REST1 mode (when still no motion is detected).

config PMW3610_REST2_SAMPLE_TIME_MS
    int "REST2 mode sample period (ms)"
    default 0
    range 0 2550
    help
      Interval in milliseconds between sensor checks in REST2 mode. 0 uses the sensor’s default (100 ms).

config PMW3610_REST2_DOWNSHIFT_TIME_MS
    int "REST2 mode downshift time (ms)"
    default 0
    help
      Time in milliseconds before the sensor enters REST3 mode from REST2 mode. 0 uses the sensor’s default timing.

config PMW3610_REST3_SAMPLE_TIME_MS
    int "REST3 mode sample period (ms)"
    default 0
    range 0 2550
    help
      Interval in milliseconds between sensor checks in REST3 mode (deepest rest). 0 uses the sensor’s default timing.

choice
    prompt "PMW3610 sensor orientation"
    default PMW3610_ORIENTATION_0

config PMW3610_ORIENTATION_0
    bool "No rotation (0°)"

config PMW3610_ORIENTATION_90
    bool "Rotated 90° clockwise"

config PMW3610_ORIENTATION_180
    bool "Rotated 180° clockwise"

config PMW3610_ORIENTATION_270
    bool "Rotated 270° clockwise"

endchoice

config PMW3610_INVERT_X
    bool "Invert X axis movement"

config PMW3610_INVERT_Y
    bool "Invert Y axis movement"

config PMW3610_INVERT_SCROLL_X
    bool "Invert scroll X axis"
    default PMW3610_INVERT_X

config PMW3610_INVERT_SCROLL_Y
    bool "Invert scroll Y axis"
    default PMW3610_INVERT_Y

config PMW3610_AUTOMOUSE_TIMEOUT_MS
    int "Auto-mouse layer timeout (ms)"
    default 400
    help
      Duration (in milliseconds) that the mouse layer remains active after the last trackball movement, when using automatic mouse layer switching.

config PMW3610_MOVEMENT_THRESHOLD
    int "Auto-mouse activation threshold"
    default 5
    help
      Amount of movement (in sensor counts) required to trigger automatic mouse layer activation. Higher values require more movement to switch into mouse mode (avoids accidental mode switches).

config PMW3610_CS_HIZ_AFTER_XFER
    bool "Tri-state CS pin after SPI transfers"
    default y
    help
      **Enable this if the PMW3610’s chip-select line is shared with other functions (such as a matrix column).** When enabled, the driver will release the CS GPIO to a high-impedance state (input) whenever it is not actively communicating with the sensor. This prevents the PMW3610 from driving the line except during SPI transfers, avoiding conflicts on that pin.

# Removed PMW3610_ADJUSTABLE_MOUSESPEED and PMW3610_CS_GPIO_MANUAL (unused/duplicate options)

module = PMW3610
module-str = PMW3610
source "${ZEPHYR_BASE}/subsys/logging/Kconfig.template.log_config"

endif # PMW3610
```
